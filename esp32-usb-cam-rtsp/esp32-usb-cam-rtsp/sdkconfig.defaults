## esp32-usb-cam-rtsp/esp32-usb-cam-rtsp/sdkconfig.defaults
```kconfig
# ESP32-CAM Configuration for ESP-IDF 5.x
# PSRAM MUST be enabled for high resolution streaming

# ===========================================
# PSRAM / SPIRAM Configuration (CRITICAL!)
# ===========================================
CONFIG_ESP32_SPIRAM_SUPPORT=y
CONFIG_SPIRAM=y
CONFIG_SPIRAM_MODE_QUAD=y
CONFIG_SPIRAM_TYPE_AUTO=y
CONFIG_SPIRAM_SPEED_80M=y
CONFIG_SPIRAM_BOOT_INIT=y
CONFIG_SPIRAM_IGNORE_NOTFOUND=n
CONFIG_SPIRAM_USE_CAPS_ALLOC=y
CONFIG_SPIRAM_MALLOC_ALWAYSINTERNAL=16384
CONFIG_SPIRAM_MALLOC_RESERVE_INTERNAL=32768
CONFIG_SPIRAM_MEMTEST=y

# ===========================================
# Camera Configuration
# ===========================================
CONFIG_CAMERA_TASK_STACK_SIZE=4096
CONFIG_CAMERA_CORE0_TASK_PINNED=y
CONFIG_CAMERA_DMA_BUFFER_SIZE_MAX=32768

# ===========================================
# Flash Configuration
# ===========================================
CONFIG_ESPTOOLPY_FLASHSIZE_4MB=y
CONFIG_ESPTOOLPY_FLASHFREQ_80M=y
CONFIG_ESPTOOLPY_FLASHMODE_QIO=y

# ===========================================
# Power Management
# ===========================================
CONFIG_ESP_BROWNOUT_DET=n

# ===========================================
# WiFi Configuration
# ===========================================
CONFIG_ESP_WIFI_STATIC_RX_BUFFER_NUM=10
CONFIG_ESP_WIFI_DYNAMIC_RX_BUFFER_NUM=32
CONFIG_ESP_WIFI_DYNAMIC_TX_BUFFER_NUM=32
CONFIG_ESP_WIFI_AMPDU_TX_ENABLED=y
CONFIG_ESP_WIFI_AMPDU_RX_ENABLED=y

# ===========================================
# LWIP / Network
# ===========================================
CONFIG_LWIP_TCP_SND_BUF_DEFAULT=5744
CONFIG_LWIP_TCP_WND_DEFAULT=5744
CONFIG_LWIP_TCP_RECVMBOX_SIZE=12
CONFIG_LWIP_UDP_RECVMBOX_SIZE=12
CONFIG_LWIP_TCPIP_RECVMBOX_SIZE=32

# ===========================================
# FreeRTOS
# ===========================================
CONFIG_FREERTOS_HZ=1000
CONFIG_FREERTOS_TIMER_TASK_STACK_DEPTH=3072
```

## esp32-usb-cam-rtsp/sdkconfig.defaults
```kconfig
# ESP32-CAM PSRAM Configuration for ESP-IDF 5.x

# PSRAM Support
CONFIG_ESP32_SPIRAM_SUPPORT=y
CONFIG_SPIRAM=y
CONFIG_SPIRAM_MODE_QUAD=y
CONFIG_SPIRAM_TYPE_AUTO=y
CONFIG_SPIRAM_SPEED_80M=y
CONFIG_SPIRAM_BOOT_INIT=y
CONFIG_SPIRAM_USE_CAPS_ALLOC=y
CONFIG_SPIRAM_MALLOC_ALWAYSINTERNAL=16384
CONFIG_SPIRAM_MALLOC_RESERVE_INTERNAL=32768

# Camera
CONFIG_CAMERA_TASK_STACK_SIZE=2048
CONFIG_CAMERA_CORE0_TASK_PINNED=y

# Flash
CONFIG_ESPTOOLPY_FLASHSIZE_4MB=y
CONFIG_ESPTOOLPY_FLASHFREQ_80M=y

# Brownout
CONFIG_ESP_BROWNOUT_DET=n
```
